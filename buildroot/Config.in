## buildroot/package/sysmon/Config.in
```kconfig
config BR2_PACKAGE_SYSMON
    bool "sysmon"
    depends on BR2_INSTALL_LIBSTDCPP
    help
      Lightweight Linux system monitor exposing metrics over HTTP.
```
